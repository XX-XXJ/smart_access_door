## sdkconfig.defaults
```kconfig
CONFIG_PARTITION_TABLE_CUSTOM=y
CONFIG_PARTITION_TABLE_CUSTOM_FILENAME="partitions.csv"
CONFIG_PARTITION_TABLE_FILENAME="partitions.csv"

CONFIG_FREERTOS_HZ=1000

CONFIG_I2C_SKIP_LEGACY_CONFLICT_CHECK=y
CONFIG_I2C_SUPPRESS_DEPRECATE_WARN=y
```
